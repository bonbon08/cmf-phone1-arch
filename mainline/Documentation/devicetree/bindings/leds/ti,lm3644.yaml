## mainline/Documentation/devicetree/bindings/leds/ti,lm3644.yaml
```yaml
# SPDX-License-Identifier: GPL-2.0-only OR BSD-2-Clause
%YAML 1.2
---
$id: http://devicetree.org/schemas/leds/ti,lm3644.yaml#
$schema: http://devicetree.org/meta-schemas/core.yaml#

title: LM3644 dual flash LED driver

maintainers:
  - CMF Phone 1 (Tetris) port

description: |
  The LM3644 drives two flash LED outputs over I2C, in torch or flash mode.
  The driver exposes the outputs listed as child nodes as one LED flash class
  device: both outputs of a dual-LED flash module light together. The first
  child node carries the LED properties. Without child nodes both outputs are
  used. The CMF Phone 1 has a register-compatible chip (device id 0x0a) with
  8-bit current codes.

properties:
  compatible:
    oneOf:
      - const: ti,lm3644
      - description: vendor device tree of the CMF Phone 1, same chip
        const: mediatek,lm3644

  reg:
    maxItems: 1

  enable-gpios:
    description: HWEN and further enable pins (active high), all driven together.
    minItems: 1
    maxItems: 2

  "#address-cells":
    const: 1

  "#size-cells":
    const: 0

patternProperties:
  "^led@[01]$":
    type: object
    $ref: common.yaml#
    unevaluatedProperties: false
    properties:
      reg:
        description: LED output, 0 or 1.
        maximum: 1

      led-max-microamp:
        description: Torch current of each output (default 200 mA).
        minimum: 750
        maximum: 386000

      flash-max-microamp:
        description: Flash current of each output (default 1.5 A).
        minimum: 2940
        maximum: 1500000

      flash-max-timeout-us:
        minimum: 200000
        maximum: 1600000

    required:
      - reg

required:
  - compatible
  - reg

additionalProperties: false

examples:
  - |
    #include <dt-bindings/gpio/gpio.h>
    #include <dt-bindings/leds/common.h>

    i2c {
        #address-cells = <1>;
        #size-cells = <0>;

        flash-led@63 {
            compatible = "ti,lm3644";
            reg = <0x63>;
            enable-gpios = <&pio 155 GPIO_ACTIVE_HIGH>, <&pio 151 GPIO_ACTIVE_HIGH>;
            #address-cells = <1>;
            #size-cells = <0>;

            led@0 {
                reg = <0>;
                function = LED_FUNCTION_FLASH;
                color = <LED_COLOR_ID_WHITE>;
                led-max-microamp = <200000>;
                flash-max-microamp = <1500000>;
                flash-max-timeout-us = <400000>;
            };

            led@1 {
                reg = <1>;
            };
        };
    };
```

## mainline/Documentation/devicetree/bindings/mfd/mediatek,mt6375.yaml
```yaml
# SPDX-License-Identifier: GPL-2.0-only OR BSD-2-Clause
%YAML 1.2
---
$id: http://devicetree.org/schemas/mfd/mediatek,mt6375.yaml#
$schema: http://devicetree.org/meta-schemas/core.yaml#

title: MediaTek MT6375 SubPMIC

maintainers:
  - CMF Phone 1 (Tetris) port

description: |
  The MT6375 combines a switching charger, a USB Type-C port controller (TCPCI
  with USB PD), a fuel gauge and ADCs. It answers on several I2C addresses
  (0x34 PMU, 0x4E TCPC, 0x1A gauge, 0x4A and 0x64 housekeeping, 0x3F test);
  the node is the PMU address. Its 128 event bits are an interrupt controller
  for the child devices, numbered as in the vendor's dt-bindings/mfd/mt6375.h
  (for example 120 pd_evt, 44 adc_donei).

properties:
  compatible:
    const: mediatek,mt6375

  reg:
    maxItems: 1

  interrupts:
    maxItems: 1

  interrupt-controller: true

  "#interrupt-cells":
    const: 1

  wakeup-source: true

  tcpc:
    type: object
    additionalProperties: false
    description: USB Type-C port controller on the TCPCI core.

    properties:
      compatible:
        const: mediatek,mt6375-tcpc

      interrupts:
        maxItems: 1

      interrupt-names:
        const: pd_evt

      vbus-supply:
        description: VBUS source for the port (the charger's OTG boost).

      connector:
        type: object
        $ref: /schemas/connector/usb-connector.yaml#
        unevaluatedProperties: false

    required:
      - compatible
      - interrupts
      - connector

  chg:
    type: object
    additionalProperties: false
    description: Switching charger with BC1.2 detection and the OTG boost.

    properties:
      compatible:
        const: mediatek,mt6375-chg

      interrupts:
        maxItems: 6

      interrupt-names:
        items:
          - const: fl_pwr_rdy
          - const: fl_detach
          - const: fl_bc12_dn
          - const: fl_vbus_ov
          - const: fl_chg_tout
          - const: fl_wdt

      monitored-battery:
        description: |
          simple-battery node; constant-charge-voltage-max-microvolt,
          constant-charge-current-max-microamp and charge-term-current-microamp
          set the charge limits.

      usb-otg-vbus:
        type: object
        $ref: /schemas/regulator/regulator.yaml#
        unevaluatedProperties: false
        description: OTG boost (4.85 V to 6 V, 0.5 A to 2.4 A), VBUS for the TCPC.

    required:
      - compatible
      - interrupts
      - interrupt-names

patternProperties:
  "^(adc|mtk-gauge)$":
    type: object
    description: ADC and fuel gauge; no mainline drivers yet.

required:
  - compatible
  - reg
  - interrupts
  - interrupt-controller
  - "#interrupt-cells"

additionalProperties: false

examples:
  - |
    #include <dt-bindings/interrupt-controller/irq.h>
    #include <dt-bindings/usb/pd.h>

    i2c {
        #address-cells = <1>;
        #size-cells = <0>;

        pmic@34 {
            compatible = "mediatek,mt6375";
            reg = <0x34>;
            interrupts-extended = <&pio 15 IRQ_TYPE_LEVEL_LOW>;
            interrupt-controller;
            #interrupt-cells = <1>;

            tcpc {
                compatible = "mediatek,mt6375-tcpc";
                interrupts = <120>;
                interrupt-names = "pd_evt";

                connector {
                    compatible = "usb-c-connector";
                    label = "USB-C";
                    data-role = "dual";
                    power-role = "dual";
                    try-power-role = "sink";
                    source-pdos = <PDO_FIXED(5000, 1500, PDO_FIXED_DUAL_ROLE)>;
                    sink-pdos = <PDO_FIXED(5000, 3000, PDO_FIXED_DUAL_ROLE)>;
                    op-sink-microwatt = <15000000>;
                };
            };
        };
    };
```
